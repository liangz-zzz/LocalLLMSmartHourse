## firmware/respeaker-satellite/main/Kconfig.projbuild
```kconfig
menu "ReSpeaker Satellite"

config SATELLITE_WIFI_SSID
    string "Wi-Fi SSID"
    default ""
    help
        Local Wi-Fi SSID used by the satellite device.

config SATELLITE_WIFI_PASSWORD
    string "Wi-Fi password"
    default ""
    help
        Local Wi-Fi password. Keep it in local sdkconfig, not in git.

config SATELLITE_WS_URL
    string "Voice server WebSocket URL"
    default ""
    help
        Example: ws://192.168.18.228:8765/ws

config SATELLITE_DEVICE_ID
    string "Device ID"
    default "respeaker-satellite"
    help
        Stable identifier sent in the hello handshake.

config SATELLITE_AUTH_TOKEN
    string "Voice server auth token"
    default ""
    help
        Optional shared secret for ws_server authentication.

config SATELLITE_WAKE_WORD
    string "Fixed wake word"
    default "小鸭小鸭"
    help
        Reserved for local metadata. The current firmware build uses an official WakeNet model
        compiled for "小鸭小鸭", regardless of this local string.

config SATELLITE_PING_INTERVAL_SEC
    int "WebSocket ping interval (seconds)"
    range 5 300
    default 20
    help
        Ping cadence once the WebSocket is connected.

config SATELLITE_MANUAL_TEST_CAPTURE_MS
    int "Manual serial test capture duration (milliseconds)"
    range 1000 15000
    default 4000
    help
        Duration of microphone uplink when the serial 'w' test command is used.

config SATELLITE_WAKE_CAPTURE_MAX_MS
    int "Wake capture max duration (milliseconds)"
    range 1000 15000
    default 6000
    help
        Hard cap for the real wake-word capture path. The host usually stops the
        uplink earlier with stop_capture once VAD detects end-of-speech.

config SATELLITE_UPLINK_LEAD_IN_DISCARD_MS
    int "Discard uplink lead-in after wake prompt (milliseconds)"
    range 0 1000
    default 250
    help
        Drops the first slice of microphone audio after the local wake prompt so the
        host does not see prompt tail or wake-residual noise as the start of speech.

config SATELLITE_FOLLOW_UP_ENABLED
    bool "Enable wake-free follow-up turns after TTS"
    default y
    help
        Keeps the current session open after a reply and starts a short local
        listening window so the next user utterance does not need a wake word.

config SATELLITE_FOLLOW_UP_COOLDOWN_MS
    int "Follow-up cooldown after TTS (milliseconds)"
    range 0 1500
    default 250
    depends on SATELLITE_FOLLOW_UP_ENABLED
    help
        Wait time after TTS playback ends before the device starts its follow-up
        speech detector. This helps avoid speaker tail being mistaken for a new turn.

config SATELLITE_FOLLOW_UP_LISTEN_MS
    int "Follow-up local listen window (milliseconds)"
    range 1000 15000
    default 6000
    depends on SATELLITE_FOLLOW_UP_ENABLED
    help
        Maximum time to wait for the next user utterance without requiring the
        wake word again.

config SATELLITE_FOLLOW_UP_CAPTURE_MAX_MS
    int "Follow-up capture max duration once speech starts (milliseconds)"
    range 1000 15000
    default 4000
    depends on SATELLITE_FOLLOW_UP_ENABLED
    help
        Hard cap for the follow-up capture path after local speech start has
        been detected. The host usually stops the uplink earlier with
        stop_capture.

config SATELLITE_FOLLOW_UP_RMS_THRESHOLD
    int "Follow-up speech detection RMS threshold"
    range 100 12000
    default 1200
    depends on SATELLITE_FOLLOW_UP_ENABLED
    help
        RMS threshold on post-gain int16 samples used to decide that the user has
        started speaking during the follow-up window.

endmenu
```

## firmware/respeaker-satellite/sdkconfig.defaults
```kconfig
CONFIG_SATELLITE_PING_INTERVAL_SEC=20
CONFIG_SATELLITE_MANUAL_TEST_CAPTURE_MS=8000
# Keep GPIO43/44 free for I2S and use the USB Serial/JTAG console for logs/tests.
# CONFIG_ESP_CONSOLE_UART_DEFAULT is not set
CONFIG_ESP_CONSOLE_USB_SERIAL_JTAG=y
CONFIG_ESP_CONSOLE_SECONDARY_NONE=y
CONFIG_ESPTOOLPY_FLASHSIZE_8MB=y
CONFIG_ESPTOOLPY_FLASHSIZE="8MB"
CONFIG_PARTITION_TABLE_CUSTOM=y
CONFIG_PARTITION_TABLE_CUSTOM_FILENAME="partitions.csv"
CONFIG_PARTITION_TABLE_FILENAME="partitions.csv"
CONFIG_SPIRAM=y
CONFIG_ESP32S3_SPIRAM_SUPPORT=y
CONFIG_SPIRAM_MODE_OCT=y
CONFIG_SPIRAM_SPEED_80M=y
CONFIG_SR_WN_WN9_XIAOYAXIAOYA_TTS2=y
```

## firmware/respeaker-satellite/sdkconfig.defaults.local.example
```kconfig
# Copy this file to sdkconfig.defaults.local for local-only secrets.
# This file is ignored by git and loaded automatically by CMakeLists.txt.

CONFIG_SATELLITE_WIFI_SSID="YOUR_WIFI_SSID"
CONFIG_SATELLITE_WIFI_PASSWORD="YOUR_WIFI_PASSWORD"
CONFIG_SATELLITE_WS_URL="ws://192.168.18.228:8765/ws"
CONFIG_SATELLITE_DEVICE_ID="YOUR_DEVICE_ID"
CONFIG_SATELLITE_AUTH_TOKEN=""
CONFIG_SATELLITE_WAKE_WORD="YOUR_WAKE_WORD"
```
